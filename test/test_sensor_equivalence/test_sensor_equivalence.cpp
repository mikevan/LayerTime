// LayerTime - counter-intrusion and resilient-communications firmware
// for the LilyGo T-Watch Ultra.
//
// Copyright (C) 2026 Michael Van Geertruy
//
// This program is free software: you can redistribute it and/or modify
// it under the terms of the GNU General Public License as published by
// the Free Software Foundation, either version 3 of the License, or
// (at your option) any later version.
//
// This program is distributed in the hope that it will be useful,
// but WITHOUT ANY WARRANTY; without even the implied warranty of
// MERCHANTABILITY or FITNESS FOR A PARTICULAR PURPOSE.  See the
// GNU General Public License for more details.
//
// You should have received a copy of the GNU General Public License
// along with this program.  If not, see <https://www.gnu.org/licenses/>.

// Behavior lock for the sensor extraction (layout step 5).
//
// Drives a fixed, seeded corpus of BLE advertisements and 802.11 frames
// through core's classification entry points - the exact calls the devices
// make - under every Recon selection value (0..20 and 255) and every Wi-Fi
// wants() mode, and compares every candidate produced against
// golden_894b508.txt. That file was generated by this same program compiled
// against commit 894b508, before the sensors were separated from core. Any
// change in which detector fires, its detail text, address, RSSI,
// confidence, or channel, or in the order candidates appear, fails the test.
//
//   ./tests_sensor_equivalence           compare against the golden file
//   ./tests_sensor_equivalence --emit    print the corpus output instead
//
// Run from test/ (the golden file path is relative to it).

#include <stdarg.h>
#include <stdint.h>
#include <stdio.h>
#include <string.h>

#include <string>
#include <vector>

#include "check.h"
#include "core/logic/ReconClassification.h"
#include "core/logic/ReconSelection.h"

using namespace layertime;

namespace {

std::string g_out;

void put(const char *fmt, ...) __attribute__((format(printf, 1, 2)));
void put(const char *fmt, ...)
{
    char buf[512];
    va_list ap;
    va_start(ap, fmt);
    vsnprintf(buf, sizeof(buf), fmt, ap);
    va_end(ap);
    g_out += buf;
}

// Deterministic PRNG (xorshift32), so the corpus is identical on every host.
struct Rng {
    uint32_t s;
    uint32_t next() { s ^= s << 13; s ^= s >> 17; s ^= s << 5; return s; }
    uint32_t below(uint32_t n) { return next() % n; }
};

void sink(const recon::Candidate &c, void *)
{
    put("  -> det=%u conf=%u ch=%u rssi=%d addr=%s detail=%s\n",
        static_cast<unsigned>(static_cast<uint8_t>(c.detector)),
        static_cast<unsigned>(static_cast<uint8_t>(c.confidence)),
        static_cast<unsigned>(c.channel), static_cast<int>(c.rssi),
        c.address ? c.address : "(null)", c.detail ? c.detail : "(null)");
}

// ---------------------------------------------------------------- BLE ----

struct Advert {
    std::string name;
    uint8_t address[6];
    int8_t rssi;
    std::vector<std::string> mfg;
    std::vector<uint32_t> uuids;  // > 0xFFFF means "not a 16-bit UUID"
};

void mfgThunk(uint8_t i, std::string &out, const void *ctx)
{
    out = static_cast<const Advert *>(ctx)->mfg[i];
}

// Mirrors the devices' NimBLE adapter: only 16-bit UUIDs that equal one of
// the signature UUIDs are reported.
bool uuidThunk(uint8_t i, uint16_t &out, const void *ctx)
{
    const uint32_t v = static_cast<const Advert *>(ctx)->uuids[i];
    if (v > 0xFFFF) return false;
    for (const auto &sig : recon::kBleUuidSignatures) {
        if (sig.uuid != v) continue;
        out = sig.uuid;
        return true;
    }
    return false;
}

std::string mfgRecord(uint16_t company, std::initializer_list<uint8_t> rest)
{
    std::string s;
    s.push_back(static_cast<char>(company & 0xFF));
    s.push_back(static_cast<char>(company >> 8));
    for (uint8_t b : rest) s.push_back(static_cast<char>(b));
    return s;
}

std::vector<Advert> bleCorpus()
{
    std::vector<Advert> v;
    const uint8_t plain[6] = {0x11, 0x22, 0x33, 0x44, 0x55, 0x66};
    auto make = [&](const char *name, const uint8_t *addr) {
        Advert a;
        a.name = name;
        memcpy(a.address, addr ? addr : plain, 6);
        a.rssi = -60;
        return a;
    };
    for (const auto &sig : recon::kBleUuidSignatures) {
        Advert a = make("", nullptr);
        a.uuids.push_back(sig.uuid);
        v.push_back(a);
        Advert b = make("Named", nullptr);
        b.uuids = {0x1234, 0x10000, sig.uuid};
        v.push_back(b);
    }
    for (uint8_t sub : {0x12, 0x1E, 0x07, 0x10}) {
        Advert a = make("", nullptr);
        a.mfg.push_back(mfgRecord(lts::kAppleCompanyId, {sub, 0x19}));
        v.push_back(a);
    }
    {
        Advert a = make("", nullptr);
        a.mfg.push_back(mfgRecord(lts::kAppleCompanyId, {}));
        a.mfg.push_back(std::string(1, '\x4C'));
        a.mfg.push_back(std::string());
        v.push_back(a);
    }
    for (const char *n : {"", "Penguin-123", "FS Ext Battery", "1234567890", "123456789", "Other"}) {
        Advert a = make(n, nullptr);
        a.mfg.push_back(mfgRecord(lts::kXuntongCompanyId, {0x01}));
        v.push_back(a);
    }
    {
        Advert a = make("", nullptr);
        a.mfg.push_back(mfgRecord(lts::kAppleCompanyId, {0x12}));
        a.mfg.push_back(mfgRecord(lts::kXuntongCompanyId, {}));
        a.uuids = {0xFEED, 0x3081};
        v.push_back(a);
    }
    for (const auto &sig : lts::kOuiSignatures) {
        uint8_t addr[6] = {sig.oui[0], sig.oui[1], sig.oui[2], 0x01, 0x02, 0x03};
        v.push_back(make("", addr));
        Advert b = make("Cam", addr);
        b.uuids.push_back(0xFD5F);
        v.push_back(b);
    }
    Rng rng{0x5EED1234u};
    for (int i = 0; i < 400; ++i) {
        Advert a;
        static const char *const names[] = {"", "Penguin-9", "1234567890", "x", "FS Ext Battery"};
        a.name = names[rng.below(5)];
        for (uint8_t &b : a.address) b = static_cast<uint8_t>(rng.next());
        if (rng.below(3) == 0) {
            const auto &sig = lts::kOuiSignatures[rng.below(
                sizeof(lts::kOuiSignatures) / sizeof(lts::kOuiSignatures[0]))];
            memcpy(a.address, sig.oui, 3);
        }
        a.rssi = static_cast<int8_t>(-30 - static_cast<int>(rng.below(70)));
        const uint32_t nm = rng.below(4);
        for (uint32_t m = 0; m < nm; ++m) {
            std::string rec;
            const uint32_t pick = rng.below(4);
            const uint16_t company = pick == 0   ? lts::kAppleCompanyId
                                     : pick == 1 ? lts::kXuntongCompanyId
                                                 : static_cast<uint16_t>(rng.next());
            const uint32_t len = rng.below(9);
            rec.push_back(static_cast<char>(company & 0xFF));
            rec.push_back(static_cast<char>(company >> 8));
            for (uint32_t k = 0; k < len; ++k) rec.push_back(static_cast<char>(rng.next()));
            if (rng.below(6) == 0) rec.resize(rng.below(2));
            a.mfg.push_back(rec);
        }
        const uint32_t nu = rng.below(4);
        for (uint32_t u = 0; u < nu; ++u) {
            if (rng.below(2) == 0)
                a.uuids.push_back(recon::kBleUuidSignatures[rng.below(
                    sizeof(recon::kBleUuidSignatures) / sizeof(recon::kBleUuidSignatures[0]))].uuid);
            else
                a.uuids.push_back(rng.below(0x20000));
        }
        v.push_back(a);
    }
    return v;
}

void runBle()
{
    const std::vector<Advert> corpus = bleCorpus();
    std::vector<int> selections;
    for (int s = 0; s <= 20; ++s) selections.push_back(s);
    selections.push_back(255);
    for (int s : selections) {
        put("BLE selection=%d\n", s);
        for (size_t i = 0; i < corpus.size(); ++i) {
            const Advert &a = corpus[i];
            char printed[18];
            lts::formatMac(printed, sizeof(printed), a.address);
            recon::BleAdvertSource src;
            src.name = a.name.data();
            src.nameLength = a.name.size();
            src.printedAddress = printed;
            src.addressBytes = a.address;
            src.rssi = a.rssi;
            src.manufacturerCount = static_cast<uint8_t>(a.mfg.size());
            src.manufacturer = mfgThunk;
            src.uuidCount = static_cast<uint8_t>(a.uuids.size());
            src.uuid16 = uuidThunk;
            src.context = &a;
            const size_t before = g_out.size();
            put(" advert %zu\n", i);
            const size_t mark = g_out.size();
            recon::classifyBleAdvert(src, static_cast<ReconTarget>(s), sink, nullptr);
            if (g_out.size() == mark) g_out.resize(before);  // keep only adverts that matched
        }
    }
}

// -------------------------------------------------------------- Wi-Fi ----

struct Frame {
    std::vector<uint8_t> bytes;
    int8_t rssi;
    uint8_t channel;
    uint32_t atMs;
};

std::vector<uint8_t> mgmt(uint8_t subtype, const uint8_t *transmitter, size_t length)
{
    std::vector<uint8_t> f(length, 0);
    if (length > 0) f[0] = static_cast<uint8_t>(subtype << 4);  // type 0 (management)
    if (length >= 16) memcpy(&f[10], transmitter, 6);
    return f;
}

std::vector<uint8_t> beacon(const uint8_t *bssid, const char *ssid, size_t ssidLength,
                            bool privacy)
{
    std::vector<uint8_t> f = mgmt(0x08, bssid, 38 + ssidLength);
    f[34] = privacy ? 0x10 : 0x00;
    f[36] = 0x00;
    f[37] = static_cast<uint8_t>(ssidLength);
    memcpy(&f[38], ssid, ssidLength);
    return f;
}

std::vector<Frame> wifiCorpus()
{
    std::vector<Frame> v;
    uint32_t t = 1000;
    auto add = [&](std::vector<uint8_t> bytes, uint32_t dt, uint8_t ch = 6) {
        t += dt;
        v.push_back(Frame{bytes, static_cast<int8_t>(-40 - static_cast<int>(v.size() % 50)), ch, t});
    };
    const uint8_t macA[6] = {0x02, 0xAA, 0xAA, 0xAA, 0xAA, 0x01};
    const uint8_t macB[6] = {0x02, 0xBB, 0xBB, 0xBB, 0xBB, 0x02};
    // Deauth burst from A (fires at the 6th frame), the cooldown, then again.
    for (int i = 0; i < 8; ++i) add(mgmt(0x0C, macA, 26), 100);
    for (int i = 0; i < 7; ++i) add(mgmt(0x0C, macA, 26), 2000);
    add(mgmt(0x0C, macA, 26), 16000);
    for (int i = 0; i < 6; ++i) add(mgmt(0x0C, macA, 26), 50);
    // Disassoc from B spread past the window, then a real burst.
    for (int i = 0; i < 6; ++i) add(mgmt(0x0A, macB, 26), 900);
    for (int i = 0; i < 6; ++i) add(mgmt(0x0A, macB, 26), 10);
    // Short frames.
    add(mgmt(0x08, macA, 10), 5);
    add(mgmt(0x08, macA, 30), 5);
    add(mgmt(0x0C, macA, 23), 5);
    // Pwnagotchi.
    const uint8_t pwn[6] = {0xDE, 0xAD, 0xBE, 0xEF, 0xDE, 0xAD};
    add(beacon(pwn, "pwn", 3, false), 5);
    // Every OUI signature as a beacon BSSID.
    for (const auto &sig : lts::kOuiSignatures) {
        const uint8_t b[6] = {sig.oui[0], sig.oui[1], sig.oui[2], 0x10, 0x20, 0x30};
        add(beacon(b, "net", 3, true), 5);
    }
    // Axon SSID prefixes, including case and near misses.
    const uint8_t plain[6] = {0x02, 0x10, 0x20, 0x30, 0x40, 0x50};
    for (const char *s : {"AB2-1234", "ab3-x", "AB4-", "axon-cam", "AB5-1", "AB2", "AXON"})
        add(beacon(plain, s, strlen(s), true), 5);
    // Pineapple OUIs, open and protected.
    for (uint32_t oui : {0x001337u, 0x02C0CAu, 0x00C0CAu, 0x1CBFCEu, 0x0CEFAFu, 0xDEADBEu, 0x123456u}) {
        const uint8_t b[6] = {static_cast<uint8_t>(oui >> 16), static_cast<uint8_t>(oui >> 8),
                              static_cast<uint8_t>(oui), 0x01, 0x02, 0x03};
        add(beacon(b, "open", 4, false), 5);
        add(beacon(b, "wpa", 3, true), 5);
    }
    // Several SSIDs from one BSSID: three names confirmed, a hidden name, an
    // unsafe name, a fifth name, then everything goes stale and returns.
    const uint8_t multi[6] = {0x02, 0x77, 0x77, 0x77, 0x77, 0x77};
    const char hidden[4] = {0, 0, 0, 0};
    for (int r = 0; r < 4; ++r) {
        add(beacon(multi, "Alpha", 5, true), 100);
        add(beacon(multi, "Beta", 4, true), 100);
        add(beacon(multi, "Gam,ma\"\x01", 8, true), 100);
        add(beacon(multi, hidden, 4, true), 100);
        add(beacon(multi, "", 0, true), 100);
    }
    for (const char *n : {"D1", "E2", "D1", "E2", "D1", "E2"}) add(beacon(multi, n, strlen(n), true), 100);
    add(beacon(multi, "Alpha", 5, true), 61000);
    for (int r = 0; r < 3; ++r) {
        add(beacon(multi, "Alpha", 5, true), 100);
        add(beacon(multi, "Zeta", 4, true), 100);
    }
    // A beacon whose first element is not the SSID, and an over-long length.
    {
        std::vector<uint8_t> f = beacon(plain, "AB2-x", 5, true);
        f[36] = 0x01;
        add(f, 5);
        std::vector<uint8_t> g = beacon(plain, "AB2-x", 5, true);
        g[37] = 40;
        add(g, 5);
    }
    // Seeded fuzz.
    Rng rng{0xC0FFEE11u};
    for (int i = 0; i < 600; ++i) {
        const uint32_t kind = rng.below(5);
        uint8_t mac[6];
        for (uint8_t &b : mac) b = static_cast<uint8_t>(rng.next());
        if (rng.below(3) == 0) {
            const auto &sig = lts::kOuiSignatures[rng.below(
                sizeof(lts::kOuiSignatures) / sizeof(lts::kOuiSignatures[0]))];
            memcpy(mac, sig.oui, 3);
        }
        if (rng.below(8) == 0) memcpy(mac, rng.below(2) ? macA : multi, 6);
        std::vector<uint8_t> f;
        if (kind <= 1) {
            static const char *const ssids[] = {"AB3-77", "Home", "Guest", "AXON-1", "x", ""};
            const char *s = ssids[rng.below(6)];
            f = beacon(mac, s, strlen(s), rng.below(2) == 0);
        } else if (kind == 2) {
            f = mgmt(rng.below(2) ? 0x0C : 0x0A, mac, 26);
        } else {
            f.resize(rng.below(120));
            for (uint8_t &b : f) b = static_cast<uint8_t>(rng.next());
        }
        add(f, rng.below(1500), static_cast<uint8_t>(1 + rng.below(13)));
    }
    return v;
}

struct WantsMode {
    bool monitoring;
    ReconTarget selection;
    bool earlyWarning;
};

bool wantsFn(ReconTarget detector, const void *ctx)
{
    const WantsMode *m = static_cast<const WantsMode *>(ctx);
    return recon::wants(m->monitoring, m->selection, m->earlyWarning, detector);
}

void runWifi()
{
    const std::vector<Frame> corpus = wifiCorpus();
    std::vector<int> selections;
    for (int s = 0; s <= 20; ++s) selections.push_back(s);
    selections.push_back(255);
    for (int monitoring = 0; monitoring <= 1; ++monitoring)
        for (int s : selections)
            for (int ew = 0; ew <= 1; ++ew) {
                put("WIFI monitoring=%d selection=%d earlyWarning=%d\n", monitoring, s, ew);
                WantsMode mode{monitoring != 0, static_cast<ReconTarget>(s), ew != 0};
                recon::WifiFrameClassifier classifier;
                for (size_t i = 0; i < corpus.size(); ++i) {
                    const Frame &f = corpus[i];
                    const size_t before = g_out.size();
                    put(" frame %zu t=%u\n", i, f.atMs);
                    const size_t mark = g_out.size();
                    classifier.classify(f.bytes.data(), static_cast<uint16_t>(f.bytes.size()),
                                        f.rssi, f.channel, f.atMs, wantsFn, &mode, sink,
                                        nullptr);
                    if (g_out.size() == mark) g_out.resize(before);
                }
                classifier.reset();
            }
}

std::string readFile(const char *path)
{
    FILE *f = fopen(path, "rb");
    if (!f) return std::string();
    std::string s;
    char buf[65536];
    size_t n;
    while ((n = fread(buf, 1, sizeof(buf), f)) > 0) s.append(buf, n);
    fclose(f);
    std::string out;
    for (char c : s) if (c != '\r') out.push_back(c);
    return out;
}

const char *const kGolden = "test_sensor_equivalence/golden_894b508.txt";

void ble_and_wifi_output_matches_the_pre_extraction_golden()
{
    g_out.clear();
    runBle();
    runWifi();
    const std::string golden = readFile(kGolden);
    CHECK_TRUE(!golden.empty());
    if (golden.empty()) return;
    if (golden == g_out) {
        CHECK_TRUE(true);
        return;
    }
    // Report the first differing line with its context header.
    size_t pos = 0, line = 1;
    while (pos < golden.size() && pos < g_out.size() && golden[pos] == g_out[pos]) {
        if (golden[pos] == '\n') ++line;
        ++pos;
    }
    auto lineAt = [](const std::string &s, size_t p) {
        size_t b = s.rfind('\n', p == 0 ? 0 : p - 1);
        b = (b == std::string::npos) ? 0 : b + 1;
        size_t e = s.find('\n', p);
        return s.substr(b, e == std::string::npos ? std::string::npos : e - b);
    };
    char msg[700];
    snprintf(msg, sizeof(msg), "first difference at line %zu: golden \"%s\" vs actual \"%s\"",
             line, lineAt(golden, pos).c_str(), lineAt(g_out, pos).c_str());
    check::fail(__FILE__, __LINE__, msg);
    ++check::g_checks;
}

} // namespace

int main(int argc, char **argv)
{
    if (argc > 1 && strcmp(argv[1], "--emit") == 0) {
        runBle();
        runWifi();
        fwrite(g_out.data(), 1, g_out.size(), stdout);
        return 0;
    }
    CHECK_MAIN(argc, argv);
    CASE(ble_and_wifi_output_matches_the_pre_extraction_golden);
    CHECK_SUMMARY();
}
